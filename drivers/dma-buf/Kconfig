## drivers/dma-buf/Kconfig
```kconfig
menu "DMABUF options"

config SYNC_FILE
	bool "Explicit Synchronization Framework"
	default n
	select DMA_SHARED_BUFFER
	---help---
	  The Sync File Framework adds explicit syncronization via
	  userspace. It enables send/receive 'struct dma_fence' objects to/from
	  userspace via Sync File fds for synchronization between drivers via
	  userspace components. It has been ported from Android.

	  The first and main user for this is graphics in which a fence is
	  associated with a buffer. When a job is submitted to the GPU a fence
	  is attached to the buffer and is transferred via userspace, using Sync
	  Files fds, to the DRM driver for example. More details at
	  Documentation/sync_file.txt.

config SW_SYNC
	bool "Sync File Validation Framework"
	default n
	depends on SYNC_FILE
	depends on DEBUG_FS
	---help---
	  A sync object driver that uses a 32bit counter to coordinate
	  synchronization.  Useful when there is no hardware primitive backing
	  the synchronization.

	  WARNING: improper use of this can result in deadlocking kernel
	  drivers from userspace. Intended for test and debug only.

config DMABUF_HEAPS
	bool "DMA-BUF User Space Heaps"
	select DMA_SHARED_BUFFER
	---help---
	  This options provides a framework for allocating buffers from
	  various heaps. This allows userspace to allocate dma-bufs from
	  specific heaps which can then be passed around for use by
	  drivers.

	  Chooses to enable the DMA-BUF heaps framework, which
	  provides a standard way of exposing memory regions to
	  userspace via dma-buf.

	  If you're not using any of the heaps, or don't know what
	  this is, say N.

config DMABUF_HEAPS_SYSTEM
	bool "DMA-BUF System Heap"
	depends on DMABUF_HEAPS
	---help---
	  Choose this option to enable the system DMA-BUF heap used to
	  allocate pages that are managed by the kernel's page allocator.
	  These are poolable memory which can be used for general purpose
	  consumers, and is functionally similar to the ION "system" heap.

	  If you do not know what this is, say N.

endmenu
```
